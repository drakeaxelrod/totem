/* Override flash partitions: remove SoftDevice, app starts at 0x1000 */
&flash0 {
	partitions {
		/delete-node/ partition@1000;  /* Remove SoftDevice partition */
		/delete-node/ partition@27000; /* Remove old code_partition */

		code_partition: partition@1000 {
			label = "code_partition";
			reg = <0x00001000 0x000ec000>;
		};
	};
};

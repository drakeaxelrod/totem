## config/boards/shields/totem/Kconfig.defconfig
```kconfig
if SHIELD_TOTEM_DONGLE

config ZMK_KEYBOARD_NAME
    default "TOTEM"

config USB_DEVICE_PRODUCT
    default "Totem Dongle"

config ZMK_SPLIT_ROLE_CENTRAL
    default y

config ZMK_SPLIT
    default y

config ZMK_SPLIT_BLE_CENTRAL_PERIPHERALS
    default 2

config BT_MAX_CONN
    default 7

config BT_MAX_PAIRED
    default 7

config ZMK_SPLIT_BLE_CENTRAL_BATTERY_LEVEL_FETCHING
    default y

config ZMK_SPLIT_BLE_CENTRAL_BATTERY_LEVEL_PROXY
    default y

config ZMK_USB_BOOT
    default y

config ZMK_STUDIO
    default y

endif

if SHIELD_TOTEM_LEFT

config USB_DEVICE_PRODUCT
    default "Totem Left"

config ZMK_SPLIT
    default y

config ZMK_SLEEP
    default y

config ZMK_IDLE_SLEEP_TIMEOUT
    default 900000

config ZMK_IDLE_TIMEOUT
    default 30000

endif

if SHIELD_TOTEM_RIGHT

config USB_DEVICE_PRODUCT
    default "Totem Right"

config ZMK_SPLIT
    default y

config ZMK_SLEEP
    default y

config ZMK_IDLE_SLEEP_TIMEOUT
    default 900000

config ZMK_IDLE_TIMEOUT
    default 30000

endif

# ── Settings reset with correct flash partition ──

if SHIELD_TOTEM_RESET

config ZMK_SETTINGS_RESET_ON_START
    default y

config ZMK_BLE_CLEAR_BONDS_ON_START
    default y

endif
```

## config/boards/shields/totem/Kconfig.shield
```kconfig
config SHIELD_TOTEM_LEFT
    def_bool $(shields_list_contains,totem_left)

config SHIELD_TOTEM_RIGHT
    def_bool $(shields_list_contains,totem_right)

config SHIELD_TOTEM_SETTINGS_RESET
    def_bool $(shields_list_contains,totem_settings_reset)
```

## zmk/boards/shields/totem/Kconfig.defconfig
```kconfig
if SHIELD_TOTEM_LEFT

config ZMK_KEYBOARD_NAME
    default "TOTEM"

config ZMK_SPLIT_ROLE_CENTRAL
    default y

endif

if SHIELD_TOTEM_LEFT || SHIELD_TOTEM_RIGHT

config ZMK_SPLIT
    default y

endif

# ── Dongle mode: USB receiver + both halves as peripherals ──

if SHIELD_TOTEM_DONGLE_CENTRAL

config ZMK_KEYBOARD_NAME
    default "TOTEM"

config ZMK_SPLIT_ROLE_CENTRAL
    default y

config ZMK_SPLIT
    default y

config ZMK_SPLIT_BLE_CENTRAL_PERIPHERALS
    default 2

config BT_MAX_CONN
    default 7

config BT_MAX_PAIRED
    default 7

endif

if SHIELD_TOTEM_DONGLE_LEFT || SHIELD_TOTEM_DONGLE_RIGHT

config ZMK_SPLIT
    default y

endif

# ── Settings reset with correct flash partition ──

if SHIELD_TOTEM_SETTINGS_RESET

config ZMK_SETTINGS_RESET_ON_START
    default y

config ZMK_BLE_CLEAR_BONDS_ON_START
    default y

endif
```

## zmk/boards/shields/totem/Kconfig.shield
```kconfig
config SHIELD_TOTEM_LEFT
    def_bool $(shields_list_contains,totem_left)

config SHIELD_TOTEM_RIGHT
    def_bool $(shields_list_contains,totem_right)

config SHIELD_TOTEM_DONGLE_CENTRAL
    def_bool $(shields_list_contains,totem_dongle_central)

config SHIELD_TOTEM_DONGLE_LEFT
    def_bool $(shields_list_contains,totem_dongle_left)

config SHIELD_TOTEM_DONGLE_RIGHT
    def_bool $(shields_list_contains,totem_dongle_right)

config SHIELD_TOTEM_SETTINGS_RESET
    def_bool $(shields_list_contains,totem_settings_reset)
```
